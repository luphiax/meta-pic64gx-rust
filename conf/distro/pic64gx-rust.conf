## conf/distro/pic64gx-rust.conf
```bitbake
require conf/distro/mchp-distro.conf

DISTRO = "pic64gx-rust"
DISTRO_NAME = "PIC64GX Rust Distro"
DISTROOVERRIDES = "${DISTRO}:mchp-distro"

PREFERRED_VERSION_zephyr-kernel = "4.3.99"

BB_ENV_PASSTHROUGH_ADDITIONS .= " PIC64GX_STANDALONE_FIRMWARE_PROVIDER PIC64GX_ZEPHYR_APP PIC64GX_BAREMETAL_APP CARGO_HOME RUSTUP_HOME"
PIC64GX_STANDALONE_FIRMWARE_PROVIDER ?= "zephyr"
PIC64GX_ZEPHYR_APP ?= "blinky_amp"
PIC64GX_BAREMETAL_APP ?= "test2_init_uart"

BBMASK += " \
    .*/meta-mchp/meta-mchp-pic64/dynamic-layers/zephyrcore/recipes-bsp/u-boot/u-boot-mchp_.*\.bbappend \
    .*/meta-mchp/meta-mchp-pic64/dynamic-layers/zephyrcore/recipes-mchp/packagegroups/packagegroup-mchp-apps\.bbappend \
    .*/meta-mchp/meta-mchp-pic64/dynamic-layers/zephyrcore/recipes-mchp/pic64gx-zephyr-amp-demo/pic64gx-zephyr-amp-demo\.bb \
    .*/meta-mchp/meta-mchp-pic64/dynamic-layers/zephyrcore/recipes-mchp/pic64gx-zephyr-amp-demo/pic64gx-zephyr-amp-demo-hss\.bb \
"
```

## conf/layer.conf
```bitbake
# We have a conf and classes directory, add to BBPATH
BBPATH .= ":${LAYERDIR}"

# We have recipes-* directories, add to BBFILES
BBFILES += "${LAYERDIR}/recipes-*/*/*.bb \
            ${LAYERDIR}/recipes-*/*/*.bbappend"

BBFILE_COLLECTIONS += "pic64gx-rust"
BBFILE_PATTERN_pic64gx-rust = "^${LAYERDIR}/"
BBFILE_PRIORITY_pic64gx-rust = "6"
LAYERDIR_pic64gx_rust = "${LAYERDIR}"

LAYERDEPENDS_pic64gx-rust = "core mchp-common-distro meta-mchp-pic64-bsp zephyrcore"
LAYERSERIES_COMPAT_pic64gx-rust = "scarthgap"
```
